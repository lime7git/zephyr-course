## boards/custom_board/board.yml
```yaml
board:
  name: custom_board
  full_name: Micromouse board from scratch
  vendor: lime7git
  socs:
    - name: stm32f405xx
```

## boards/micromouse/Kconfig.micromouse
```kconfig
# Copyright (c) 2024 Pavlo Yadvychuk
# SPDX-License-Identifier: Apache-2.0

config BOARD_MICROMOUSE
	select SOC_STM32F405XX
```

## boards/micromouse/board.yml
```yaml
board:
  name: micromouse
  full_name: Micromouse
  vendor: lime7git
  socs:
    - name: stm32f405xx
```
